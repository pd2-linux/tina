## package/softwinner/liballwinner/Config.in
```kconfig
# liballwinner advanced configuration

menu "liballwinner of chip platform Configuration"

	depends on PACKAGE_liballwinner

	choice
	
		prompt "select the chip platform"
		default R16_LIBALLWINNER
		
		help
		  Select the chip platform 

		config R8_LIBALLWINNER
			bool "R8_LIBALLWINNER"

		config R16_LIBALLWINNER
			bool "R16_LIBALLWINNER"

		config R58_LIBALLWINNER
			bool "R58_LIBALLWINNER"

	endchoice
		
endmenu
```

## target/linux/sunxi/image/Config.in
```kconfig
config SUNXI_BOOT_PARTSIZE
	int "Boot filesystem partition size (in MB)"
	depends on TARGET_sunxi
	default 16

config SUNXI_RECOVERY_INITRAMFS_PARTSIZE
	int "Boot-Recovery initramfs filesystem partition size (in MB)"
	depends on TARGET_sunxi
	default 7
```
